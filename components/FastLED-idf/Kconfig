## components/FastLED-idf/Kconfig
```kconfig
menu "Fast LED"

    config FAST_LED_TEST
        bool "Create a Fast LED option in case I need to later"
        default n
        help
            I don't know if I'm going to have to add menuconfig options in the future.
            Maybe I will. If I do, this is the template for doing it.

endmenu
```

## platformio/FujiNet_idf/sdkconfig.defaults
```kconfig
# These defaults are used when generating a new sdkconfig file
# Note that this is configured for debugging. A release version will need to be
# created with different defaults. It may be possible to automatically pick the
# correct file using CMakeLists.txt.  See:
# https://docs.espressif.com/projects/esp-idf/en/latest/esp32/api-guides/build-system.html#custom-sdkconfig-defaults

CONFIG_LOG_DEFAULT_LEVEL_ERROR=y
CONFIG_LOG_DEFAULT_LEVEL=1

CONFIG_LOG_COLORS=n
CONFIG_TASK_WDT_CHECK_IDLE_TASK_CPU0=n
CONFIG_TASK_WDT_CHECK_IDLE_TASK_CPU1=n

CONFIG_COMPILER_STACK_CHECK_MODE_NORM=y
CONFIG_COMPILER_STACK_CHECK=y

CONFIG_D0WD_PSRAM_CLK_IO=17
CONFIG_D0WD_PSRAM_CS_IO=16
CONFIG_D2WD_PSRAM_CLK_IO=9
CONFIG_D2WD_PSRAM_CS_IO=10

CONFIG_ESP_HTTP_CLIENT_ENABLE_BASIC_AUTH=y

CONFIG_ESP32_SPIRAM_SUPPORT=y

CONFIG_ESP32_WIFI_STATIC_TX_BUFFER_NUM=16
CONFIG_ESP32_WIFI_STATIC_TX_BUFFER=y
CONFIG_ESP32_WIFI_TX_BUFFER_TYPE=0

CONFIG_FATFS_ALLOC_PREFER_EXTRAM=y
CONFIG_FATFS_API_ENCODING_ANSI_OEM=y
CONFIG_FATFS_LFN_HEAP=y
CONFIG_FATFS_MAX_LFN=255

CONFIG_FREERTOS_SUPPORT_STATIC_ALLOCATION=y

CONFIG_HEAP_POISONING_LIGHT=y
CONFIG_HTTPD_MAX_REQ_HDR_LEN=1024
CONFIG_PICO_PSRAM_CS_IO=10

CONFIG_SPIRAM_BANKSWITCH_ENABLE=y
CONFIG_SPIRAM_BANKSWITCH_RESERVE=8
CONFIG_SPIRAM_BOOT_INIT=y
CONFIG_SPIRAM_CACHE_WORKAROUND=y
CONFIG_SPIRAM_IGNORE_NOTFOUND=y
CONFIG_SPIRAM_MALLOC_ALWAYSINTERNAL=16384
CONFIG_SPIRAM_MALLOC_RESERVE_INTERNAL=32768
CONFIG_SPIRAM_MEMTEST=y
CONFIG_SPIRAM_SIZE=-1
CONFIG_SPIRAM_SPEED_40M=y
CONFIG_SPIRAM_SPIWP_SD3_PIN=7
CONFIG_SPIRAM_SUPPORT=y
CONFIG_SPIRAM_TYPE_AUTO=y
CONFIG_SPIRAM_USE_MALLOC=y

CONFIG_STACK_CHECK_NORM=y
CONFIG_STACK_CHECK=y

CONFIG_SUPPORT_STATIC_ALLOCATION=y
```
