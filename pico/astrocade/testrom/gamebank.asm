; gamebank.asm -- self-test program for the 256K/512K game mapper.
;
; Assembled into the LAST 4K bank of a synthetic game image by
; tools/mkgame.py: on this mapper the last bank is what the console sees
; fixed at 2000H-2FFFH, so this is both the boot menu entry and the code
; that walks every switched bank. It has no FujiNet awareness at all -- it
; runs identically on our fujinet cart device and on MAME's own
; rom_256k/rom_512k mappers, which is exactly the A/B the harness runs.
;
; Per bank: one read at the hotspot (GHOT+n) must RETURN n (the mapper
; serves the new bank number as the data byte) and switch 3000H-3FBFH to
; bank n; then the packer's stamp there must check out (marker pair, 32
; PRNG bytes) -- except the last bank, which must byte-match this program.
; Verdict to screen and to 4FA0H (0A5H pass / 5AH fail, bank in 4FA1H).
;
; GBANKS and GHOT come from ../build/gamecfg.inc, generated by build.sh for
; the 256K (64 banks, 3FC0H) and 512K (128 banks, 3F80H) variants.

        INCLUDE "HVGLIB.H"
        INCLUDE "../build/gamecfg.inc"

LINBUF  EQU     4F00H
HEXBUF  EQU     4F30H
CURBK   EQU     4F40H           ; bank under test
STACK   EQU     4FC0H
VERDICT EQU     4FA0H           ; 0A5H pass / 5AH fail
VERBANK EQU     4FA1H

VPASS   EQU     0A5H
VFAILV  EQU     05AH

LINES   EQU     96
OPTFB   EQU     0CH

        ORG     FIRSTC
        DB      55H
        DW      MENUST
        DW      PRGNAM
        DW      PRGSTR
PRGNAM: DB      "BANK MAPPER TEST"
        DB      0

PRGSTR: DI                      ; polled operation, no interrupts: I stays 0
        LD      SP,STACK
        SYSTEM  INTPC
        DO      SETOUT
        DB      LINES*2
        DB      0
        DB      8
        DO      COLSET
        DW      PALET
        DO      FILL
        DW      NORMEM
        DW      LINES*BYTEPL
        DB      0
        DO      STRDIS
        DB      2
        DB      2
        DB      OPTFB
        DW      TSTR
        EXIT

        XOR     A
        LD      (VERDICT),A

; ---- walk every bank ---------------------------------------------------
BKLOOP: LD      (CURBK),A
        LD      C,A
        LD      A,GHOTLO        ; hotspot low bytes never carry into H
        ADD     A,C
        LD      L,A
        LD      H,3FH
        LD      A,(HL)          ; switch AND read back the bank number
        CP      C
        JR      NZ,FAIL
        LD      A,(CURBK)
        LD      DE,60+14*256
        CALL    HEXAT
        LD      A,(CURBK)
        CALL    VERBK
        JR      C,FAIL
        LD      A,(CURBK)
        INC     A
        CP      GBANKS          ; 64 or 128; fits a byte either way
        JR      NZ,BKLOOP

; ---- verdict -----------------------------------------------------------
        SYSSUK  STRDIS
        DB      2
        DB      26
        DB      OPTFB
        DW      PASSTR
        LD      A,VPASS
        LD      (VERDICT),A
HALTP:  JR      HALTP

FAIL:   SYSSUK  STRDIS
        DB      2
        DB      36
        DB      OPTFB
        DW      FAILSTR
        LD      A,(CURBK)
        LD      (VERBANK),A
        LD      DE,84+36*256
        CALL    HEXAT
        LD      A,VFAILV
        LD      (VERDICT),A
HALTF:  JR      HALTF

; ---- helpers -----------------------------------------------------------

; One PRNG step, matching mkgame.py: x = (5x + 47H) & FFH.
PRSTEP: LD      B,A
        ADD     A,A
        ADD     A,A
        ADD     A,B
        ADD     A,47H
        RET

; Verify bank A as currently mapped at 3000H. Carry set on failure.
VERBK:  LD      C,A
        INC     A
        CP      GBANKS
        JR      Z,VBLAST

        LD      A,(3000H)       ; stamped bank: marker pair + PRNG
        CP      C
        JR      NZ,VBBAD
        LD      A,(3001H)
        LD      B,A
        LD      A,C
        CPL
        CP      B
        JR      NZ,VBBAD
        LD      A,C
        XOR     0A5H            ; PRNG seed
        LD      HL,3002H
        LD      E,32
VBLOOP: CALL    PRSTEP
        CP      (HL)
        JR      NZ,VBBAD
        INC     HL
        DEC     E
        JR      NZ,VBLOOP
        OR      A
        RET

VBLAST: LD      HL,3000H        ; the last bank is this program itself
        LD      DE,2000H
        LD      B,16
VBLLP:  LD      A,(DE)
        CP      (HL)
        JR      NZ,VBBAD
        INC     HL
        INC     DE
        DJNZ    VBLLP
        OR      A
        RET

VBBAD:  SCF
        RET

        INCLUDE "fujidisp.inc"

; ---- data --------------------------------------------------------------
TSTR:   DB      "BANK MAPPER TEST",0
PASSTR: DB      "PASS",0
FAILSTR:DB      "FAIL BANK",0
PALET:  DB      0E7H,40H,20H,00H
        DB      0E7H,40H,20H,00H
